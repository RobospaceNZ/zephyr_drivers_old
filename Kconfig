## Kconfig
```kconfig
# Copyright (c) 2021 Nordic Semiconductor ASA
# SPDX-License-Identifier: Apache-2.0
#
# This Kconfig file is picked by the Zephyr build system because it is defined
# as the module Kconfig entry point (see zephyr/module.yml). You can browse
# module options by going to Zephyr -> Modules in Kconfig.

menu "Zephyr"
source "Kconfig.zephyr"
endmenu

#module = rudder_sensor
#module-str = rudder_sensor
# source "subsys/logging/Kconfig.template.log_config"

rsource "drivers/Kconfig"
```

## drivers/sensor/Kconfig
```kconfig
# Copyright (c) 2021 Nordic Semiconductor ASA
# SPDX-License-Identifier: Apache-2.0

if SENSOR
rsource "as5600/Kconfig"
endif # SENSOR
```

## drivers/sensor/as5600/Kconfig
```kconfig
# Copyright (c) 2021 Nordic Semiconductor ASA
# SPDX-License-Identifier: Apache-2.0

menuconfig AS5600
	bool "AS5600 angle sensor"
	depends on (GPIO && I2C)
	help
	  Enable AS5600 angle sensor

if AS5600
module = AS5600
module-str = AS5600 Angle sensor
source "${ZEPHYR_BASE}/subsys/logging/Kconfig.template.log_config"
endif #AS5600
```

## dts/bindings/sensor/ams,as5600.yaml
```yaml
description: |
  Driver for the AS5600 Hall effect angle sensor. This driver also includes a GPIO
  which is used to power the sensor.

  Example definition in devicetree:

    sensor_as5600 {
        compatible = "ams,as5600";
        label = "AS5600";
        pwr-gpios = <&gpio0 0 (GPIO_ACTIVE_HIGH | GPIO_OUTPUT_ACTIVE | GPIO_OPEN_SOURCE | GPIO_DS_ALT_HIGH)>;
    };

compatible: "ams,as5600"

include: i2c-device.yaml

properties:
  pwr-gpios:
    type: phandle-array
    required: true
    description: GPIO used to power sensor.
```
